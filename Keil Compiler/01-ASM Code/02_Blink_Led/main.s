SYSCTL_RCGCGPIO_R equ 0x400FE608
GPIO_PORTF_LOCK_R equ 0x40025520	
GPIO_LOCK_KEY     equ 0x4C4F434B
GPIO_PORTF_DIR_R  equ 0x40025400
GPIO_PORTF_DEN_R  equ 0x4002551C
GPIO_PORTF_DATA_R equ 0x400253FC
		
		AREA |.text|, CODE, READONLY, ALIGN=2
		THUMB
		EXPORT Main

Main
		BL GPIOF_Init
loop
		BL LIGHT_ON
		B loop
		
GPIOF_Init
		LDR R1, =SYSCTL_RCGCGPIO_R
		LDR R0, [R1]
		ORR R0, R0, #0x20
		STR R0, [R1]
		NOP
		NOP
		LDR R1, =GPIO_PORTF_LOCK_R
		LDR R0, =GPIO_LOCK_KEY
		LDR R1, =GPIO_PORTF_DIR_R
		MOV R0, #0x02
		STR R0, [R1]
		LDR R1, =GPIO_PORTF_DEN_R
		MOV R0, #0x02
		STR R0, [R1]
		
		BX LR
	
LIGHT_ON
		LDR R1, =GPIO_PORTF_DATA_R
		MOV R0, #0x02
		STR R0, [R1]
		BX LR
		
		ALIGN
		END
		